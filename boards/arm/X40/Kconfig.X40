## boards/arm/X40/Kconfig.X40
```kconfig
# Copyright (c) 2021 Nick Winans
# SPDX-License-Identifier: Apache-2.0

config BOARD_X40
    select SOC_NRF52840_QIAA
    select ZMK_BOARD_COMPAT if BOARD_X40_NRF52840_ZMK
    imply RETAINED_MEM if BOARD_X40_NRF52840_ZMK
    imply RETENTION if BOARD_X40_NRF52840_ZMK
    imply RETENTION_BOOT_MODE if BOARD_X40_NRF52840_ZMK
```

## boards/arm/X40/Kconfig.defconfig
```kconfig
# Copyright (c) 2021 Nick Winans
# SPDX-License-Identifier: MIT

if BOARD_X40

config ZMK_KEYBOARD_NAME
    default "Xin"

if USB_DEVICE_STACK

config USB_NRFX
    default y

endif # USB_DEVICE_STACK

config BT_CTLR
    default BT

endif # BOARD_NICE60
```

## boards/arm/X40/board.yml
```yaml
board:
  name: X40
  vendor: Xin
  socs:
    - name: nrf52840
      variants:
        - name: zmk
```

## boards/arm/keyboard40/Kconfig.board
```kconfig
config BOARD_KEYBOARD40
    bool "keyboard40"
    select SOC_NRF52840_QIAA
    select CPU_CORTEX_M4
    select CPU_HAS_ARM_MPU
    select CPU_HAS_FPU
```

## boards/arm/keyboard40/Kconfig.defconfig
```kconfig
if BOARD_KEYBOARD40

config BOARD
    default "keyboard40"

config ARM_MPU
    default y

config USB
    bool
    default y

config USB_NRFX
    default y

config USB_DEVICE_STACK
    default y

config BT
    default y

config BT_CTLR
    default y

config ZMK_BLE
    default y

config ZMK_USB
    default y

config FLASH
    default y
    depends on SOC_FLASH_NRF || FLASH_HAS_DRIVER

config FLASH_HAS_DRIVER_ENABLED
    default y

config FLASH_HAS_PAGE_LAYOUT
    default y

config FLASH_PAGE_LAYOUT
    default y

config FLASH_MAP
    default y


config SETTINGS
    default y

config SETTINGS_NVS
    default y

config SERIAL_SUPPORT_INTERRUPT
    default y

endif # BOARD_KEYBOARD40
```

## boards/shields/X40/Kconfig.X40
```kconfig
# Copyright (c) 2021 Nick Winans
# SPDX-License-Identifier: Apache-2.0

config BOARD_X40
    select SOC_NRF52840_QIAA
    select ZMK_BOARD_COMPAT if BOARD_X40
    imply RETAINED_MEM if BOARD_X40
    imply RETENTION if BOARD_X40
    imply RETENTION_BOOT_MODE if BOARD_X40
```

## boards/shields/X40/board.yml
```yaml
board:
  name: X40
  vendor: X
  socs:
    - name: nrf52840
      variants:
        - name: zmk
```

## boards/shields/keyboard40/Kconfig.defconfig
```kconfig
if BOARD_KEYBOARD40

config ZMK_KEYBOARD_NAME
    default "keyboard40"

endif # BOARD_KEYBOARD40
```
